/*@!Encoding:936*/
variables
{
  int number = 73; 
}

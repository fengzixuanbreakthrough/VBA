/*@!Encoding:936*/
variables
{
   struct MsgRout
{
    long ID;
    int cycle;
    int Source_Chn;
    int Support_PT;
    int cycle_PT;
    long cycle_PTID;
    int Support_CH;
    int cycle_CH;
    long cycle_CHID;
    int Support_EV;
    int cycle_EV;
    long cycle_EVID;
    int Support_Com;
    int cycle_Com;
    long cycle_ComID;
    int Support_Info;
    int cycle_Info;
    long cycle_InfoID;
    int Support_Diag;
    int cycle_Diag;
    long cycle_DiagID;
    int Support_ADAS;
    int cycle_ADAS;
    long cycle_ADASID;
    int Support_CH2;
    int cycle_CH2;
    long cycle_CH2ID;
    int Support_COM2;
    int cycle_COM2;
    long cycle_COM2ID;
  }msg[1000]={
                        {0x0CF00400x,10,1,0,0,0x0x,0,0,0x0x,0,0,0x0x,1,10,0x0CF00400x,1,10,0x0CF00400x,0,0,0x0x,0,0,0x0x,0,0,0x0x,0,0,0x0x},
                        {0x18F00503x,100,1,0,0,0x0x,0,0,0x0x,0,0,0x0x,0,0,0x0x,1,100,0x18F00503x,0,0,0x0x,0,0,0x0x,0,0,0x0x,0,0,0x0x},
                        {0x18FEE000x,100,1,0,0,0x0x,0,0,0x0x,0,0,0x0x,0,0,0x0x,1,100,0x18FEE000x,0,0,0x0x,0,0,0x0x,0,0,0x0x,0,0,0x0x},
                        {0x18FEF100x,100,1,0,0,0x0x,0,0,0x0x,0,0,0x0x,0,0,0x0x,1,100,0x18FEF100x,0,0,0x0x,0,0,0x0x,0,0,0x0x,0,0,0x0x},
                        {0x18FEEF00x,500,1,0,0,0x0x,0,0,0x0x,0,0,0x0x,0,0,0x0x,1,500,0x18FEEF00x,0,0,0x0x,0,0,0x0x,0,0,0x0x,0,0,0x0x},
                        {0x18FEEE00x,1000,1,0,0,0x0x,0,0,0x0x,0,0,0x0x,1,1000,0x18FEEE00x,1,1000,0x18FEEE00x,0,0,0x0x,0,0,0x0x,0,0,0x0x,0,0,0x0x},
                        {0x18FEE500x,10,1,0,0,0x0x,0,0,0x0x,0,0,0x0x,0,0,0x0x,1,10,0x18FEE500x,0,0,0x0x,0,0,0x0x,0,0,0x0x,0,0,0x0x},
                        {0x0CFE6C17x,50,1,0,0,0x0x,0,0,0x0x,0,0,0x0x,1,50,0x0CFE6C17x,1,50,0x0CFE6C17x,0,0,0x0x,0,0,0x0x,0,0,0x0x,0,0,0x0x},
                        {0x18FEFA17x,1000,1,0,0,0x0x,0,0,0x0x,0,0,0x0x,1,1000,0x18FEFA17x,1,1000,0x18FEFA17x,0,0,0x0x,0,0,0x0x,0,0,0x0x,0,0,0x0x},
                        {0x18FEFC17x,1000,1,0,0,0x0x,0,0,0x0x,0,0,0x0x,1,1000,0x18FEFC17x,1,1000,0x18FEFC17x,0,0,0x0x,0,0,0x0x,0,0,0x0x,0,0,0x0x},
                        {0x18FECA00x,1000,1,0,0,0x0x,0,0,0x0x,0,0,0x0x,0,0,0x0x,1,1000,0x18FECA00x,0,0,0x0x,0,0,0x0x,0,0,0x0x,0,0,0x0x},
                        {0x18FECA0Bx,1000,1,0,0,0x0x,0,0,0x0x,0,0,0x0x,0,0,0x0x,1,1000,0x18FECA0Bx,0,0,0x0x,0,0,0x0x,0,0,0x0x,0,0,0x0x},
                        {0x18FECA03x,1000,1,0,0,0x0x,0,0,0x0x,0,0,0x0x,0,0,0x0x,1,1000,0x18FECA03x,0,0,0x0x,0,0,0x0x,0,0,0x0x,0,0,0x0x},
                        {0x18FECAA9x,1000,1,0,0,0x0x,0,0,0x0x,0,0,0x0x,0,0,0x0x,1,1000,0x18FECAA9x,0,0,0x0x,0,0,0x0x,0,0,0x0x,0,0,0x0x},
                        {0x1CECFF00x,10,1,0,0,0x0x,0,0,0x0x,0,0,0x0x,1,10,0x1CECFF00x,1,10,0x1CECFF00x,0,0,0x0x,0,0,0x0x,0,0,0x0x,0,0,0x0x},
                        {0x1CEBFF00x,10,1,0,0,0x0x,0,0,0x0x,0,0,0x0x,1,10,0x1CEBFF00x,1,10,0x1CEBFF00x,0,0,0x0x,0,0,0x0x,0,0,0x0x,0,0,0x0x},
                        {0x1CECFF0Bx,10,1,0,0,0x0x,0,0,0x0x,0,0,0x0x,0,0,0x0x,1,10,0x1CECFF0Bx,0,0,0x0x,0,0,0x0x,0,0,0x0x,0,0,0x0x},
                        {0x1CEBFF0Bx,10,1,0,0,0x0x,0,0,0x0x,0,0,0x0x,0,0,0x0x,1,10,0x1CEBFF0Bx,0,0,0x0x,0,0,0x0x,0,0,0x0x,0,0,0x0x},
                        {0x1CECFFA9x,10,1,0,0,0x0x,0,0,0x0x,0,0,0x0x,0,0,0x0x,1,10,0x1CECFFA9x,0,0,0x0x,0,0,0x0x,0,0,0x0x,0,0,0x0x},
                        {0x1CEBFFA9x,10,1,0,0,0x0x,0,0,0x0x,0,0,0x0x,0,0,0x0x,1,10,0x1CEBFFA9x,0,0,0x0x,0,0,0x0x,0,0,0x0x,0,0,0x0x},
                        {0x1CECFF03x,10,1,0,0,0x0x,0,0,0x0x,0,0,0x0x,0,0,0x0x,1,10,0x1CECFF03x,0,0,0x0x,0,0,0x0x,0,0,0x0x,0,0,0x0x},
                        {0x1CEBFF03x,10,1,0,0,0x0x,0,0,0x0x,0,0,0x0x,0,0,0x0x,1,10,0x1CEBFF03x,0,0,0x0x,0,0,0x0x,0,0,0x0x,0,0,0x0x},
                        {0x0CFE4131x,35,4,1,35,0x0CFE4131x,0,0,0x0x,0,0,0x0x,0,0,0x0x,1,35,0x0CFE4131x,0,0,0x0x,0,0,0x0x,0,0,0x0x,0,0,0x0x},
                        {0x18FF0131x,100,4,0,0,0x0x,0,0,0x0x,0,0,0x0x,0,0,0x0x,1,100,0x18FF0131x,0,0,0x0x,0,0,0x0x,0,0,0x0x,0,0,0x0x},
                        {0x18FF0231x,100,4,1,100,0x18FF0231x,0,0,0x0x,0,0,0x0x,0,0,0x0x,1,100,0x18FF0231x,0,0,0x0x,0,0,0x0x,0,0,0x0x,0,0,0x0x},
                        {0x18FECA31x,1000,4,1,1000,0x18FECA31x,0,0,0x0x,0,0,0x0x,0,0,0x0x,1,1000,0x18FECA31x,0,0,0x0x,0,0,0x0x,0,0,0x0x,0,0,0x0x},
                        {0x18FECA21x,1000,4,1,1000,0x18FECA21x,0,0,0x0x,0,0,0x0x,0,0,0x0x,1,1000,0x18FECA21x,0,0,0x0x,0,0,0x0x,0,0,0x0x,0,0,0x0x},
                        {0x18FECAE5x,1000,4,1,1000,0x18FECAE5x,0,0,0x0x,0,0,0x0x,0,0,0x0x,1,1000,0x18FECAE5x,0,0,0x0x,0,0,0x0x,0,0,0x0x,0,0,0x0x},
                        {0x1CECFF31x,10,4,1,10,0x1CECFF31x,0,0,0x0x,0,0,0x0x,0,0,0x0x,1,10,0x1CECFF31x,0,0,0x0x,0,0,0x0x,0,0,0x0x,0,0,0x0x},
                        {0x1CEBFF31x,10,4,1,10,0x1CEBFF31x,0,0,0x0x,0,0,0x0x,0,0,0x0x,1,10,0x1CEBFF31x,0,0,0x0x,0,0,0x0x,0,0,0x0x,0,0,0x0x},
                        {0x1CECFF21x,10,4,1,10,0x1CECFF21x,0,0,0x0x,0,0,0x0x,0,0,0x0x,1,10,0x1CECFF21x,0,0,0x0x,0,0,0x0x,0,0,0x0x,0,0,0x0x},
                        {0x1CEBFF21x,10,4,1,10,0x1CEBFF21x,0,0,0x0x,0,0,0x0x,0,0,0x0x,1,10,0x1CEBFF21x,0,0,0x0x,0,0,0x0x,0,0,0x0x,0,0,0x0x},
                        {0x1CECFFE5x,10,4,1,10,0x1CECFFE5x,0,0,0x0x,0,0,0x0x,0,0,0x0x,1,10,0x1CECFFE5x,0,0,0x0x,0,0,0x0x,0,0,0x0x,0,0,0x0x},
                        {0x1CEBFFE5x,10,4,1,10,0x1CEBFFE5x,0,0,0x0x,0,0,0x0x,0,0,0x0x,1,10,0x1CEBFFE5x,0,0,0x0x,0,0,0x0x,0,0,0x0x,0,0,0x0x},
                        {0x18FEF500x,1000,1,0,0,0x0x,0,0,0x0x,0,0,0x0x,1,1000,0x18FEF500x,0,0,0x0x,0,0,0x0x,0,0,0x0x,0,0,0x0x,0,0,0x0x},
                        {0x18FEDF00x,250,1,0,0,0x0x,0,0,0x0x,0,0,0x0x,1,250,0x18FEDF00x,0,0,0x0x,0,0,0x0x,0,0,0x0x,0,0,0x0x,0,0,0x0x},
                        {0x18FEF200x,100,1,0,0,0x0x,0,0,0x0x,0,0,0x0x,1,100,0x18FEF200x,0,0,0x0x,0,0,0x0x,0,0,0x0x,0,0,0x0x,0,0,0x0x},
                        {0x18F00E51x,1000,1,0,0,0x0x,0,0,0x0x,0,0,0x0x,1,1000,0x18F00E51x,0,0,0x0x,0,0,0x0x,0,0,0x0x,0,0,0x0x,0,0,0x0x},
                        {0x18F00F52x,1000,1,0,0,0x0x,0,0,0x0x,0,0,0x0x,1,1000,0x18F00F52x,0,0,0x0x,0,0,0x0x,0,0,0x0x,0,0,0x0x,0,0,0x0x},
                        {0x18FE5600x,1000,1,0,0,0x0x,0,0,0x0x,0,0,0x0x,1,1000,0x18FE5600x,0,0,0x0x,0,0,0x0x,0,0,0x0x,0,0,0x0x,0,0,0x0x},
                        {0x0CF00A00x,1000,1,0,0,0x0x,0,0,0x0x,0,0,0x0x,1,1000,0x0CF00A00x,0,0,0x0x,0,0,0x0x,0,0,0x0x,0,0,0x0x,0,0,0x0x},
                        {0x14FD3E00x,1000,1,0,0,0x0x,0,0,0x0x,0,0,0x0x,1,1000,0x14FD3E00x,0,0,0x0x,0,0,0x0x,0,0,0x0x,0,0,0x0x,0,0,0x0x},
                        {0x18FDB200x,1000,1,0,0,0x0x,0,0,0x0x,0,0,0x0x,1,1000,0x18FDB200x,0,0,0x0x,0,0,0x0x,0,0,0x0x,0,0,0x0x,0,0,0x0x},
                        {0x18FD7C00x,1000,1,0,0,0x0x,0,0,0x0x,0,0,0x0x,1,1000,0x18FD7C00x,0,0,0x0x,0,0,0x0x,0,0,0x0x,0,0,0x0x,0,0,0x0x},
                        {0x18E0FF00x,1000,1,0,0,0x0x,0,0,0x0x,0,0,0x0x,1,1000,0x18E0FF00x,0,0,0x0x,0,0,0x0x,0,0,0x0x,0,0,0x0x,0,0,0x0x},
                        {0x18FF7400x,1000,1,0,0,0x0x,0,0,0x0x,0,0,0x0x,1,1000,0x18FF7400x,0,0,0x0x,0,0,0x0x,0,0,0x0x,0,0,0x0x,0,0,0x0x},
                        {0x18FFDA00x,1000,1,0,0,0x0x,0,0,0x0x,0,0,0x0x,1,1000,0x18FFDA00x,0,0,0x0x,0,0,0x0x,0,0,0x0x,0,0,0x0x,0,0,0x0x},
                        {0x18FEE017x,100,1,0,0,0x0x,0,0,0x0x,0,0,0x0x,1,100,0x18FEE017x,0,0,0x0x,0,0,0x0x,0,0,0x0x,0,0,0x0x,0,0,0x0x},
                        {0x18FF11A9x,1000,1,0,0,0x0x,0,0,0x0x,0,0,0x0x,1,1000,0x18FF11A9x,0,0,0x0x,0,0,0x0x,0,0,0x0x,0,0,0x0x,0,0,0x0x},
                        {0x18FF12A9x,1000,1,0,0,0x0x,0,0,0x0x,0,0,0x0x,1,1000,0x18FF12A9x,0,0,0x0x,0,0,0x0x,0,0,0x0x,0,0,0x0x,0,0,0x0x},
                        {0x18FF13A9x,1000,1,0,0,0x0x,0,0,0x0x,0,0,0x0x,1,1000,0x18FF13A9x,0,0,0x0x,0,0,0x0x,0,0,0x0x,0,0,0x0x,0,0,0x0x},
                        {0x18FF16A9x,500,1,0,0,0x0x,0,0,0x0x,0,0,0x0x,1,500,0x18FF16A9x,0,0,0x0x,0,0,0x0x,0,0,0x0x,0,0,0x0x,0,0,0x0x},
                        {0x18FEF433x,1000,4,1,1000,0x18FEF433x,0,0,0x0x,0,0,0x0x,0,0,0x0x,0,0,0x0x,0,0,0x0x,0,0,0x0x,0,0,0x0x,0,0,0x0x},
                        {0x18FC4233x,1000,4,1,1000,0x18FC4233x,0,0,0x0x,0,0,0x0x,0,0,0x0x,0,0,0x0x,0,0,0x0x,0,0,0x0x,0,0,0x0x,0,0,0x0x},
                        {0x18FFC133x,500,4,1,500,0x18FFC133x,0,0,0x0x,0,0,0x0x,0,0,0x0x,0,0,0x0x,0,0,0x0x,0,0,0x0x,0,0,0x0x,0,0,0x0x},
                        {0x18FF1733x,200,4,1,200,0x18FF1733x,0,0,0x0x,0,0,0x0x,0,0,0x0x,0,0,0x0x,0,0,0x0x,0,0,0x0x,0,0,0x0x,0,0,0x0x},
                        {0x18F00631x,500,4,1,500,0x18F00631x,0,0,0x0x,0,0,0x0x,0,0,0x0x,0,0,0x0x,0,0,0x0x,0,0,0x0x,0,0,0x0x,0,0,0x0x},
                        {0x18FF0321x,100,4,1,100,0x18FF0321x,0,0,0x0x,0,0,0x0x,0,0,0x0x,0,0,0x0x,0,0,0x0x,0,0,0x0x,0,0,0x0x,0,0,0x0x},
                        {0x18FF04E5x,100,4,1,100,0x18FF04E5x,0,0,0x0x,0,0,0x0x,0,0,0x0x,0,0,0x0x,0,0,0x0x,0,0,0x0x,0,0,0x0x,0,0,0x0x},
                        {0x18EA0041x,10,5,1,10,0x18EA0041x,0,0,0x0x,0,0,0x0x,0,0,0x0x,0,0,0x0x,0,0,0x0x,0,0,0x0x,0,0,0x0x,0,0,0x0x},
                        {0x18DB33F1x,10,6,0,0,0x0x,0,0,0x0x,0,0,0x0x,1,10,0x18DB33F1x,0,0,0x0x,0,0,0x0x,0,0,0x0x,0,0,0x0x,0,0,0x0x},
                        {0x18DA31F1x,10,6,0,0,0x0x,0,0,0x0x,0,0,0x0x,1,10,0x18DA31F1x,0,0,0x0x,0,0,0x0x,0,0,0x0x,0,0,0x0x,0,0,0x0x},
                        {0x18DAF131x,10,4,0,0,0x0x,0,0,0x0x,0,0,0x0x,0,0,0x0x,0,0,0x0x,1,10,0x18DAF131x,0,0,0x0x,0,0,0x0x,0,0,0x0x},
                        {0x18DA21F1x,10,6,0,0,0x0x,0,0,0x0x,0,0,0x0x,1,10,0x18DA21F1x,0,0,0x0x,0,0,0x0x,0,0,0x0x,0,0,0x0x,0,0,0x0x},
                        {0x18DAF121x,10,4,0,0,0x0x,0,0,0x0x,0,0,0x0x,0,0,0x0x,0,0,0x0x,1,10,0x18DAF121x,0,0,0x0x,0,0,0x0x,0,0,0x0x},
                        {0x18DAE5F1x,10,6,0,0,0x0x,0,0,0x0x,0,0,0x0x,1,10,0x18DAE5F1x,0,0,0x0x,0,0,0x0x,0,0,0x0x,0,0,0x0x,0,0,0x0x},
                        {0x18DAF1E5x,10,4,0,0,0x0x,0,0,0x0x,0,0,0x0x,0,0,0x0x,0,0,0x0x,1,10,0x18DAF1E5x,0,0,0x0x,0,0,0x0x,0,0,0x0x},
                        {0x18DA0BF1x,10,6,1,10,0x18DA0BF1x,0,0,0x0x,0,0,0x0x,0,0,0x0x,0,0,0x0x,0,0,0x0x,0,0,0x0x,0,0,0x0x,0,0,0x0x},
                        {0x18DAF10Bx,10,1,0,0,0x0x,0,0,0x0x,0,0,0x0x,0,0,0x0x,0,0,0x0x,1,10,0x18DAF10Bx,0,0,0x0x,0,0,0x0x,0,0,0x0x},
                        {0x18DA33F1x,10,6,0,0,0x0x,0,0,0x0x,0,0,0x0x,1,10,0x18DA33F1x,0,0,0x0x,0,0,0x0x,0,0,0x0x,0,0,0x0x,0,0,0x0x},
                        {0x18DAF133x,10,4,0,0,0x0x,0,0,0x0x,0,0,0x0x,0,0,0x0x,0,0,0x0x,1,10,0x18DAF133x,0,0,0x0x,0,0,0x0x,0,0,0x0x},
                        {0x18DA41F1x,10,6,0,0,0x0x,0,0,0x0x,0,0,0x0x,1,10,0x18DA41F1x,0,0,0x0x,0,0,0x0x,0,0,0x0x,0,0,0x0x,0,0,0x0x},
                        {0x18DAF141x,10,4,0,0,0x0x,0,0,0x0x,0,0,0x0x,0,0,0x0x,0,0,0x0x,1,10,0x18DAF141x,0,0,0x0x,0,0,0x0x,0,0,0x0x}
                        };
}